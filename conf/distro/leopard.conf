## conf/distro/leopard.conf
```bitbake
DISTRO_NAME = "Leopard (KP Labs)"
DISTRO_VERSION := "build-${@bb.process.run('git rev-parse HEAD')[0].strip()}"
DISTRO_FEATURES:remove = "alsa bluetooth wifi nfc x11 pulseaudio"
SDK_NAME = "yocto_sdk_${SDK_OS}"
TOOLCHAIN_OUTPUTNAME="${MACHINE}-${SDK_NAME}"

INIT_MANAGER = "systemd"

# apply no suffix to tmp build directory
TCLIBCAPPEND := ""
```

## conf/machine/leopard-dpu-zu15eg.conf
```bitbake
require conf/machine/include/leopard-machine-common.inc

MACHINEOVERRIDES =. "leopard-dpu:"
```
