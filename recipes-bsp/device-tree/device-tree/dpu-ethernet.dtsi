&gem2 {
    phy-handle = <&phy0>;
    mdio {
      phy0: phy@0 {
         reg = <0>;
         vddio-supply = <&vddio>;
         qca,clk-out-strength = <0>; // FULL

         vddio: vddio-regulator {
             regulator-min-microvolt = <1800000>;
             regulator-max-microvolt = <1800000>;
         };
      };
    };
};