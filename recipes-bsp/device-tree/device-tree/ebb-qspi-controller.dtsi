&qspi {
    qspi_flash: flash@0 {
        compatible = "jedec,spi-nor";
        #address-cells = <1>;
        #size-cells = <1>;
        reg = <0x0>;
        spi-tx-bus-width = <1>;
        spi-rx-bus-width = <4>;
        spi-max-frequency = <108000000>;
        parallel-memories = /bits/ 64 <0x04000000 0x04000000>; // This is undocumented way for specifying that ints in array are 64bit. Kernel fails to initialize NOR Flashes without it.
    };
};