// Remove SPI0 node from the device tree, it is ment to be loaded in runtime
/delete-node/ &spi0;

// Fix the spi1 alias, which pointed to qspi
&{/} {
    aliases {
        spi1 = "/axi/spi@ff050000";
    };
};